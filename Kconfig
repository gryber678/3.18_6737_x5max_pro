## Kconfig
```kconfig
#
# For a description of the syntax of this configuration file,
# see Documentation/kbuild/kconfig-language.txt.
#
mainmenu "Linux/$ARCH $KERNELVERSION Kernel Configuration"

config SRCARCH
	string
	option env="SRCARCH"

source "arch/$SRCARCH/Kconfig"
menu "Tweaks"
config MORPH_CPU_MORPH6737T
	bool 'Overclocking to 6737t freqs'
endmenu
#source "drivers/misc/mediatek/gpu/gpu_mali/mali_midgard/mali-r7p0_v2/drivers/gpu/arm/midgard/Kconfig"
```
