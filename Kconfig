## arch/arm/configs/n370b_defconfig
```kconfig
###### Custom config n370b (Doogee x5 max pro) ######
CONFIG_ARCH_MT6735M=y
CONFIG_MTK_PLATFORM=MT6735
# CONFIG_ARM_PATCH_PHYS_VIRT is not set
CONFIG_PHYS_OFFSET=0x40000000
CONFIG_CROSS_COMPILE="arm-eabi-"
# CONFIG_LOCALVERSION_AUTO is not set
CONFIG_AUDIT=y
CONFIG_NO_HZ=y
CONFIG_HIGH_RES_TIMERS=y
CONFIG_IKCONFIG=y
CONFIG_IKCONFIG_PROC=y
CONFIG_CGROUPS=y
CONFIG_CGROUP_CPUACCT=y
CONFIG_RESOURCE_COUNTERS=y
CONFIG_CGROUP_SCHED=y
CONFIG_RT_GROUP_SCHED=y
CONFIG_BLK_DEV_INITRD=y
CONFIG_EMBEDDED=y
CONFIG_PROFILING=y
CONFIG_OPROFILE=y
CONFIG_CC_STACKPROTECTOR_REGULAR=y
# CONFIG_BLK_DEV_BSG is not set
CONFIG_SMP=y
CONFIG_HAVE_ARM_ARCH_TIMER=y
CONFIG_NR_CPUS=8
CONFIG_ARM_PSCI=y
CONFIG_PREEMPT=y
CONFIG_AEABI=y
CONFIG_HIGHMEM=y
CONFIG_ZSMALLOC=y
CONFIG_SECCOMP=y
CONFIG_USE_OF=y
##############################
CONFIG_BUILD_ARM_APPENDED_DTB_IMAGE=y
CONFIG_BUILD_ARM_APPENDED_DTB_IMAGE_NAMES="n370b"
CONFIG_CMDLINE="console=tty0 console=ttyMT3,921600n1 root=/dev/ram vmalloc=496M slub_max_order=0 slub_debug=O "
##############################
CONFIG_AUTO_ZRELADDR=y
##############################
CONFIG_CPU_FREQ=y
CONFIG_CPU_FREQ_STAT_DETAILS=y
CONFIG_CPU_FREQ_DEFAULT_GOV_INTERACTIVE=y
CONFIG_CPU_FREQ_GOV_PERFORMANCE=y
CONFIG_CPU_FREQ_GOV_POWERSAVE=y
################################
CONFIG_VFP=y
CONFIG_NEON=y
# CONFIG_CORE_DUMP_DEFAULT_ELF_HEADERS is not set
CONFIG_HIBERNATION=y
CONFIG_TOI_CORE=y
# CONFIG_TOI_FILE is not set
CONFIG_TOI_DEFAULT_WAIT=2
CONFIG_PM_AUTOSLEEP=y
CONFIG_PM_WAKELOCKS=y
################################
CONFIG_NET=y
CONFIG_PACKET=y
CONFIG_UNIX=y
CONFIG_XFRM_USER=y
CONFIG_XFRM_SUB_POLICY=y
CONFIG_XFRM_MIGRATE=y
CONFIG_NET_KEY=y
CONFIG_INET=y
CONFIG_IP_MULTICAST=y
CONFIG_IP_ADVANCED_ROUTER=y
CONFIG_IP_MULTIPLE_TABLES=y
CONFIG_IP_PNP=y
CONFIG_IP_PNP_DHCP=y
CONFIG_IP_PNP_BOOTP=y
CONFIG_NET_IPIP=y
CONFIG_IP_MROUTE=y
CONFIG_IP_MROUTE_MULTIPLE_TABLES=y
CONFIG_IP_PIMSM_V1=y
CONFIG_IP_PIMSM_V2=y
CONFIG_SYN_COOKIES=y
CONFIG_INET_AH=y
CONFIG_INET_ESP=y
CONFIG_INET_IPCOMP=y
# CONFIG_INET_LRO is not set
CONFIG_IPV6_ROUTER_PREF=y
CONFIG_IPV6_ROUTE_INFO=y
CONFIG_IPV6_OPTIMISTIC_DAD=y
CONFIG_INET6_AH=y
CONFIG_INET6_ESP=y
CONFIG_INET6_IPCOMP=y
CONFIG_IPV6_MIP6=y
CONFIG_INET6_XFRM_MODE_ROUTEOPTIMIZATION=y
CONFIG_IPV6_SIT_6RD=y
CONFIG_IPV6_TUNNEL=y
CONFIG_IPV6_MULTIPLE_TABLES=y
CONFIG_IPV6_SUBTREES=y
CONFIG_IPV6_MROUTE=y
CONFIG_IPV6_PIMSM_V2=y
CONFIG_NETFILTER=y
CONFIG_NF_CONNTRACK=y
CONFIG_NF_CONNTRACK_EVENTS=y
CONFIG_NF_CT_PROTO_UDPLITE=y
CONFIG_NF_CONNTRACK_FTP=y
CONFIG_NF_CONNTRACK_PPTP=y
CONFIG_NF_CONNTRACK_SIP=y
CONFIG_NF_CONNTRACK_TFTP=y
CONFIG_NF_CT_NETLINK=y
CONFIG_NETFILTER_XT_CONNMARK=y
CONFIG_NETFILTER_XT_TARGET_CLASSIFY=y
CONFIG_NETFILTER_XT_TARGET_IDLETIMER=y
CONFIG_NETFILTER_XT_TARGET_MARK=y
CONFIG_NETFILTER_XT_TARGET_NFLOG=y
CONFIG_NETFILTER_XT_TARGET_NFQUEUE=y
CONFIG_NETFILTER_XT_TARGET_TCPMSS=y
CONFIG_NETFILTER_XT_MATCH_CONNBYTES=y
CONFIG_NETFILTER_XT_MATCH_IPRANGE=y
CONFIG_NETFILTER_XT_MATCH_LENGTH=y
CONFIG_NETFILTER_XT_MATCH_LIMIT=y
CONFIG_NETFILTER_XT_MATCH_MAC=y
CONFIG_NETFILTER_XT_MATCH_MARK=y
CONFIG_NETFILTER_XT_MATCH_MULTIPORT=y
CONFIG_NETFILTER_XT_MATCH_POLICY=y
CONFIG_NETFILTER_XT_MATCH_PHYSDEV=y
CONFIG_NETFILTER_XT_MATCH_QTAGUID=y
CONFIG_NETFILTER_XT_MATCH_QUOTA=y
CONFIG_NETFILTER_XT_MATCH_QUOTA2=y
CONFIG_NETFILTER_XT_MATCH_QUOTA2_LOG=y
CONFIG_NETFILTER_XT_MATCH_REALM=y
CONFIG_NETFILTER_XT_MATCH_RECENT=y
CONFIG_NETFILTER_XT_MATCH_SOCKET=y
CONFIG_NETFILTER_XT_MATCH_STATE=y
CONFIG_NETFILTER_XT_MATCH_STATISTIC=y
CONFIG_NETFILTER_XT_MATCH_STRING=y
CONFIG_NETFILTER_XT_MATCH_TCPMSS=y
CONFIG_NETFILTER_XT_MATCH_TIME=y
CONFIG_NETFILTER_XT_MATCH_U32=y
CONFIG_NF_CONNTRACK_IPV4=y
CONFIG_IP_NF_IPTABLES=y
CONFIG_IP_NF_FILTER=y
CONFIG_IP_NF_TARGET_REJECT=y
CONFIG_IP_NF_NAT=y
CONFIG_IP_NF_TARGET_MASQUERADE=y
CONFIG_IP_NF_TARGET_NETMAP=y
CONFIG_IP_NF_TARGET_REDIRECT=y
CONFIG_IP_NF_MANGLE=y
CONFIG_IP_NF_RAW=y
CONFIG_IP_NF_ARPTABLES=y
CONFIG_NF_CONNTRACK_IPV6=y
CONFIG_IP6_NF_IPTABLES=y
CONFIG_IP6_NF_MATCH_FRAG=y
CONFIG_IP6_NF_MATCH_IPV6HEADER=y
CONFIG_IP6_NF_TARGET_HL=y
CONFIG_IP6_NF_FILTER=y
CONFIG_IP6_NF_TARGET_REJECT=y
CONFIG_IP6_NF_MANGLE=y
CONFIG_IP6_NF_RAW=y
CONFIG_BRIDGE=y
CONFIG_VLAN_8021Q=y
CONFIG_NET_SCHED=y
CONFIG_NET_SCH_HTB=y
CONFIG_NET_SCH_INGRESS=y
CONFIG_NET_CLS_FW=y
CONFIG_NET_CLS_U32=y
CONFIG_CLS_U32_PERF=y
CONFIG_CLS_U32_MARK=y
CONFIG_NET_CLS_FLOW=y
CONFIG_NET_CLS_ACT=y
CONFIG_NET_ACT_POLICE=y
CONFIG_NET_ACT_MIRRED=y
CONFIG_NET_ACT_IPT=y
CONFIG_NET_CLS_IND=y
CONFIG_CFG80211=y
CONFIG_NL80211_TESTMODE=y
CONFIG_CFG80211_DEVELOPER_WARNINGS=y
# CONFIG_CFG80211_DEFAULT_PS is not set
CONFIG_CFG80211_DEBUGFS=y
CONFIG_CFG80211_INTERNAL_REGDB=y
#########################################
CONFIG_MTD=y
# CONFIG_MTD_OF_PARTS is not set
CONFIG_MTD_BLOCK=y
CONFIG_MTD_NAND_IDS=y
CONFIG_ZRAM=y
CONFIG_ZRAM_DEBUG=y
CONFIG_BLK_DEV_LOOP=y
CONFIG_UID_STAT=y
CONFIG_UID_CPUTIME=y
CONFIG_MEDIATEK_SOLUTION=y
CONFIG_MTK_PLATFORM="mt6735"
CONFIG_ARCH_MTK_PROJECT="n370b"
CONFIG_MTK_MEMCFG=y
CONFIG_MTK_SHARED_SDCARD=y
CONFIG_MTK_GPT_SCHEME_SUPPORT=y
CONFIG_MTK_SENSOR_SUPPORT=y
########## Drivers ##################
CONFIG_CUSTOM_KERNEL_IMGSENSOR="gc5024_mipi_raw gc5005_mipi_raw hi553_mipi_raw hi843b_mipi_raw hi841_mipi_raw mn045_mipi_raw hi544_mipi_raw"
CONFIG_MTK_VIDEOCODEC_DRIVER=y
CONFIG_MTK_LEDS=y
CONFIG_MTK_VIBRATOR=y
CONFIG_MTK_JPEG=y
CONFIG_MTK_SYSENV=y
CONFIG_MTK_LCM=y
CONFIG_CUSTOM_KERNEL_LCM="otm1283a_cmi50_tps65132_hd"
CONFIG_MTK_FB=y
CONFIG_MTK_CONSYS_6735=y
CONFIG_MTK_VIDEOX=y
CONFIG_MTK_LCM_PHYSICAL_ROTATION="0"
CONFIG_LCM_HEIGHT="1280"
CONFIG_LCM_WIDTH="780"
CONFIG_MTK_AAL_SUPPORT=y
CONFIG_MTK_DRAMC=y
CONFIG_MTK_SYNC=y
CONFIG_MTK_PWM=y
CONFIG_MAGNETOMETER=qmc6983-new
CONFIG_ALSPS=epl259x-new
CONFIG_ACCELEROMETER=KXTJ2_1009-new
CONFIG_MTK_HWMON=y
CONFIG_MTK_FREQ_HOPPING=y
CONFIG_MTK_ACCDET=y
CONFIG_ACCDET_EINT_IRQ=y
CONFIG_MTK_SEC_MODEM_NVRAM_ANTI_CLONE=y
CONFIG_MTK_DEBUG_LATCH=y
CONFIG_MTK_LASTPC=y
CONFIG_MTK_WATCHPOINT=y
CONFIG_MTPROF=y
CONFIG_MTK_WQ_DEBUG=y
CONFIG_MT_SCHED_MONITOR=y
CONFIG_MT_RT_THROTTLE_MON=y
CONFIG_PREEMPT_MONITOR=y
CONFIG_MTK_MUSB_QMU_SUPPORT=y
CONFIG_USB_MTK_OTG=y
CONFIG_MTK_CMDQ=y
CONFIG_MTK_SMI_EXT=y
CONFIG_MTK_CLKMGR=y
CONFIG_MTK_CHIP=y
CONFIG_MTK_MD1_SUPPORT=5
CONFIG_MTK_NET_CCMNI=y
CONFIG_MTK_ECCCI_DRIVER=y
CONFIG_CUSTOM_KERNEL_SSW="ssw_single_v2"
CONFIG_MTK_DEVAPC_DRIVER=y
CONFIG_MTK_GPU_SUPPORT=y
CONFIG_MTK_GPU_VERSION="mali midgard r7p0"
CONFIG_MTK_GPU_COMMON_DVFS_SUPPORT=y
CONFIG_MTK_MMPROFILE_SUPPORT=y
CONFIG_MMPROFILE=y
CONFIG_INPUT_TOUCHSCREEN=y
CONFIG_TOUCHSCREEN_MTK=y

###################################
CONFIG_MTK_RAM_CONSOLE=y
CONFIG_MTK_RAM_CONSOLE_USING_DRAM=y
CONFIG_MTK_RAM_CONSOLE_SIZE=0x3000
CONFIG_MTK_RAM_CONSOLE_ADDR=0xF912D000
CONFIG_MTK_RAM_CONSOLE_DRAM_SIZE=0x10000
CONFIG_MTK_RAM_CONSOLE_DRAM_ADDR=0x43F00000
CONFIG_MTK_SCHED_RQAVG_KS=y
CONFIG_MTK_SCHED_RQAVG_US=y
CONFIG_MT_CPU_AFFINITY=y
CONFIG_MT_LOAD_BALANCE_ENHANCEMENT=y
CONFIG_MT_SCHED_INTEROP=y
CONFIG_MT_SCHED_TRACE=y
CONFIG_MTK_FMRADIO=y
CONFIG_MTK_FM=y
CONFIG_MTK_FM_SUPPORT=y
CONFIG_MTK_FM_CHIP="MT6625_FM"
CONFIG_MTK_IMGSENSOR=y
CONFIG_MTK_BTIF=y
CONFIG_MTK_COMBO=y
CONFIG_MTK_COMBO_CHIP_CONSYS_6735=y
CONFIG_MTK_COMBO_BT=y
CONFIG_MTK_COMBO_GPS=y
CONFIG_MTK_COMBO_WIFI=y
CONFIG_MTK_PASSPOINT_R1_SUPPORT=y
CONFIG_MTK_GPS_SUPPORT=y
CONFIG_MTK_NFC=n
CONFIG_MTK_LENS=y
CONFIG_MTK_LENS_FM50AF_SUPPORT=y
CONFIG_MTK_LENS_GW9714AF_SUPPORT=y
CONFIG_MTK_FLASHLIGHT=y
CONFIG_CUSTOM_KERNEL_FLASHLIGHT="constant_flashlight"
CONFIG_MTK_AEE_FEATURE=y
CONFIG_MTK_THERMAL_PA_VIA_ATCMD=y
CONFIG_MTK_RTC=y
CONFIG_MTK_EMI_D2P=y
CONFIG_MTK_BTCVSD=y
CONFIG_SCSI=y
CONFIG_BLK_DEV_SD=y
CONFIG_SCSI_SCAN_ASYNC=y
# CONFIG_SCSI_LOWLEVEL is not set
CONFIG_MD=y
CONFIG_BLK_DEV_DM=y
CONFIG_DM_DEBUG=y
CONFIG_DM_CRYPT=y
CONFIG_DM_UEVENT=y
CONFIG_DM_VERITY=y
CONFIG_NETDEVICES=y
CONFIG_IFB=y
CONFIG_TUN=y
# CONFIG_ETHERNET is not set
CONFIG_PPP=y
CONFIG_PPP_BSDCOMP=y
CONFIG_PPP_DEFLATE=y
CONFIG_PPP_FILTER=y
CONFIG_PPP_MPPE=y
CONFIG_PPP_MULTILINK=y
CONFIG_PPPOE=y
CONFIG_PPPOLAC=y
CONFIG_PPPOPNS=y
CONFIG_PPP_ASYNC=y
CONFIG_PPP_SYNC_TTY=y
# CONFIG_INPUT_MOUSEDEV is not set
CONFIG_INPUT_EVDEV=y
# CONFIG_KEYBOARD_ATKBD is not set
# CONFIG_INPUT_MOUSE is not set
CONFIG_KEYBOARD_MTK=y
CONFIG_TWOKEY_REBOOT_NORMAL_MODE=y
CONFIG_TWOKEY_REBOOT_OTHER_MODE=y
CONFIG_KPD_PWRKEY_USE_PMIC=y
CONFIG_INPUT_MISC=y
CONFIG_INPUT_UINPUT=y
# CONFIG_SERIO is not set
# CONFIG_VT is not set
CONFIG_LEGACY_PTY_COUNT=16
# CONFIG_HW_RANDOM is not set
CONFIG_I2C=y
CONFIG_SPI=y
CONFIG_MTK_SPI=y
CONFIG_POWER_SUPPLY=y
CONFIG_POWER_RESET=y
CONFIG_MTK_SMART_BATTERY=y
CONFIG_MTK_KERNEL_POWER_OFF_CHARGING=y
CONFIG_MTK_PUMP_EXPRESS_SUPPORT=y
# CONFIG_HWMON is not set
CONFIG_THERMAL=y
CONFIG_THERMAL_DEFAULT_GOV_BACKWARD_COMPATIBLE=y
CONFIG_WATCHDOG=y
CONFIG_REGULATOR=y
CONFIG_FB=y
CONFIG_FB_MODE_HELPERS=y
CONFIG_FB_TILEBLITTING=y
CONFIG_LOGO=y
CONFIG_SOUND=y
CONFIG_SND=y
CONFIG_SND_SEQUENCER=y
CONFIG_SND_SEQ_DUMMY=y
CONFIG_SND_MIXER_OSS=y
CONFIG_SND_PCM_OSS=y
CONFIG_SND_SEQUENCER_OSS=y
CONFIG_SND_HRTIMER=y
CONFIG_SND_DYNAMIC_MINORS=y
CONFIG_SND_VERBOSE_PRINTK=y
CONFIG_SND_DEBUG=y
CONFIG_SND_DEBUG_VERBOSE=y
CONFIG_SND_PCM_XRUN_DEBUG=y
# CONFIG_SND_SPI is not set
CONFIG_SND_USB_AUDIO=y
CONFIG_SND_SOC=y
CONFIG_MT_SND_SOC_V3=y
CONFIG_MTK_SPEAKER=y
CONFIG_SND_SIMPLE_CARD=y
CONFIG_SOUND_PRIME=y
CONFIG_HIDRAW=y
CONFIG_UHID=y
CONFIG_HID_A4TECH=y
CONFIG_HID_APPLE=y
CONFIG_HID_BELKIN=y
CONFIG_HID_CHERRY=y
CONFIG_HID_CHICONY=y
CONFIG_HID_CYPRESS=y
CONFIG_HID_DRAGONRISE=y
CONFIG_HID_EZKEY=y
CONFIG_HID_KYE=y
CONFIG_HID_GYRATION=y
CONFIG_HID_TWINHAN=y
CONFIG_HID_KENSINGTON=y
CONFIG_HID_LOGITECH=y
CONFIG_HID_MAGICMOUSE=y
CONFIG_HID_MICROSOFT=y
CONFIG_HID_MONTEREY=y
CONFIG_HID_PANTHERLORD=y
CONFIG_HID_PETALYNX=y
CONFIG_HID_SAMSUNG=y
CONFIG_HID_SUNPLUS=y
CONFIG_HID_GREENASIA=y
CONFIG_HID_SMARTJOYPLUS=y
CONFIG_HID_TOPSEED=y
CONFIG_HID_THRUSTMASTER=y
CONFIG_HID_ZEROPLUS=y
CONFIG_USB=y
CONFIG_USB_STORAGE=y
CONFIG_USB_STORAGE_DEBUG=y
CONFIG_USB_STORAGE_DATAFAB=y
CONFIG_USB_STORAGE_FREECOM=y
CONFIG_USB_STORAGE_ISD200=y
CONFIG_USB_STORAGE_USBAT=y
CONFIG_USB_STORAGE_SDDR09=y
CONFIG_USB_STORAGE_SDDR55=y
CONFIG_USB_STORAGE_JUMPSHOT=y
CONFIG_USB_STORAGE_ALAUDA=y
CONFIG_USB_STORAGE_ONETOUCH=y
CONFIG_USB_STORAGE_KARMA=y
CONFIG_USB_STORAGE_CYPRESS_ATACB=y
CONFIG_USB_TRANCEVIBRATOR=y
CONFIG_NOP_USB_XCEIV=y
CONFIG_USB_GADGET=y
CONFIG_USB_GADGET_VBUS_DRAW=500
CONFIG_USB_G_ANDROID=y
CONFIG_MMC=y
CONFIG_MMC_BLOCK_MINORS=32
CONFIG_MMC_MTK=y
CONFIG_MTK_EMMC_SUPPORT=y
CONFIG_MTK_EMMC_CACHE=y
CONFIG_NEW_LEDS=y
CONFIG_LEDS_CLASS=y
CONFIG_LEDS_TRIGGERS=y
CONFIG_LEDS_TRIGGER_TIMER=y
CONFIG_SWITCH=y
CONFIG_RTC_CLASS=y
# CONFIG_RTC_SYSTOHC is not set
CONFIG_STAGING=y
CONFIG_ANDROID=y
CONFIG_ANDROID_BINDER_IPC=y
CONFIG_ASHMEM=y
CONFIG_ANDROID_LOW_MEMORY_KILLER=y
CONFIG_SYNC=y
CONFIG_SW_SYNC=y
CONFIG_SW_SYNC_USER=y
CONFIG_ION=y
CONFIG_MTK_ION=y
CONFIG_EXT4_FS=y
CONFIG_EXT4_FS_SECURITY=y
CONFIG_EXT4_FS_ENCRYPTION=y
CONFIG_EXT4_DEBUG=y
CONFIG_FUSE_FS=y
CONFIG_ISO9660_FS=y
CONFIG_JOLIET=y
CONFIG_ZISOFS=y
CONFIG_MSDOS_FS=y
CONFIG_VFAT_FS=y
CONFIG_TMPFS=y
CONFIG_PSTORE=y
CONFIG_PSTORE_CONSOLE=y
CONFIG_PSTORE_PMSG=y
CONFIG_PSTORE_RAM=y
CONFIG_PSTORE_CONSOLE_SIZE=0x10000
CONFIG_PSTORE_PMSG_SIZE=0x10000
CONFIG_PSTORE_MEM_ADDR=0x43F10000
CONFIG_PSTORE_MEM_SIZE=0xe0000
# CONFIG_NETWORK_FILESYSTEMS is not set
CONFIG_NLS_CODEPAGE_437=y
CONFIG_NLS_CODEPAGE_950=y
CONFIG_NLS_ASCII=y
CONFIG_NLS_ISO8859_1=y
CONFIG_NLS_UTF8=y
CONFIG_PRINTK_TIME=y
CONFIG_DYNAMIC_DEBUG=y
CONFIG_DEBUG_INFO=y
CONFIG_FRAME_WARN=1400
CONFIG_SLUB_DEBUG_ON=y
CONFIG_DEBUG_KMEMLEAK=y
CONFIG_DEBUG_KMEMLEAK_EARLY_LOG_SIZE=3200
CONFIG_DEBUG_KMEMLEAK_DEFAULT_OFF=y
CONFIG_DETECT_HUNG_TASK=y
CONFIG_PANIC_ON_OOPS=y
CONFIG_PANIC_TIMEOUT=5
CONFIG_SCHEDSTATS=y
CONFIG_PROVE_LOCKING=y
CONFIG_DEBUG_LOCKDEP=y
CONFIG_DEBUG_ATOMIC_SLEEP=y
CONFIG_DEBUG_LIST=y
CONFIG_RCU_CPU_STALL_TIMEOUT=60
CONFIG_RCU_TRACE=y
CONFIG_FAULT_INJECTION=y
CONFIG_ENABLE_DEFAULT_TRACERS=y
CONFIG_MTK_SCHED_TRACERS=y
CONFIG_MTK_FTRACE_DEFAULT_ENABLE=y
CONFIG_DMA_API_DEBUG=y
CONFIG_KGDB=y
CONFIG_KGDB_KDB=y
# CONFIG_ARM_UNWIND is not set
CONFIG_SECURITY=y
CONFIG_SECURITY_NETWORK=y
CONFIG_SECURITY_SELINUX=y
CONFIG_SECURITY_SELINUX_BOOTPARAM=y
CONFIG_CRYPTO_NULL=y
CONFIG_CRYPTO_XCBC=y
CONFIG_CRYPTO_AES_ARM=y
CONFIG_CRYPTO_TWOFISH=y
CONFIG_CRYPTO_LZO=y
# CONFIG_CRYPTO_ANSI_CPRNG is not set
# CONFIG_CRYPTO_HW is not set
CONFIG_LIBCRC32C=y
CONFIG_ACCDET_EINT=n
CONFIG_ACCDET_EINT_IRQ=y
CONFIG_FINGERPRINT_MICROARRAY_FP=y
CONFIG_GTP_AUTO_UPDATE=
CONFIG_GTP_DRIVER_SEND_CFG=
CONFIG_GTP_HEADER_FW_UPDATE=
CONFIG_GTP_HOTKNOT=
CONFIG_GTP_POWER_CTRL_SLEEP=
CONFIG_LCM_HEIGHT=1280
CONFIG_LCM_WIDTH=720
#CONFIG_MTK_AAL_SUPPORT=
CONFIG_MTK_ACWFDIALOG_APP=y
CONFIG_MTK_AGPS_APP=y
CONFIG_MTK_ANDROIDFACTORYMODE_APP=y
CONFIG_MTK_API_CHECK=y
CONFIG_MTK_APPENDED_DTB_SUPPORT=y
CONFIG_MTK_APP_GUIDE=y
CONFIG_MTK_ASD_SUPPORT=y
CONFIG_MTK_ATF_SUPPORT=y
CONFIG_MTK_AUDENH_SUPPORT=y
CONFIG_MTK_AUDIO=y
CONFIG_MTK_AUDIO_ADPCM_SUPPORT=y
CONFIG_MTK_AUDIO_ALAC_SUPPORT=y
CONFIG_MTK_AUDIO_APE_SUPPORT=y
CONFIG_MTK_AUDIO_HD_REC_SUPPORT=y
CONFIG_MTK_AUDIO_MIC_INVERSE=y
CONFIG_MTK_AUDIO_PROFILES=y
CONFIG_MTK_AUDIO_RAW_SUPPORT=y
CONFIG_MTK_AUTORAMA_SUPPORT=y
CONFIG_MTK_AUTO_DETECT_ACCELEROMETER=
CONFIG_MTK_AUTO_DETECT_ALSPS=
CONFIG_MTK_AUTO_DETECT_MAGNETOMETER=
CONFIG_MTK_AVI_PLAYBACK_SUPPORT=y
CONFIG_MTK_BEAM_PLUS_SUPPORT=n
CONFIG_MTK_BESLOUDNESS_SUPPORT=y
CONFIG_MTK_BESSURROUND_SUPPORT=y
CONFIG_MTK_BG_POWER_SAVING_SUPPORT=y
CONFIG_MTK_BG_POWER_SAVING_UI_SUPPORT=y
CONFIG_MTK_BICR_SUPPORT=y
CONFIG_MTK_BIP_SCWS=y
CONFIG_MTK_BT_BLUEDROID_HFP_AG_17=y
CONFIG_MTK_BT_BLUEDROID_PLUS=y
CONFIG_MTK_BT_SUPPORT=y
CONFIG_MTK_BWC_SUPPORT=y
CONFIG_MTK_CALENDAR_IMPORTER_APP=y
CONFIG_MTK_CAMERA_APP_3DHW_SUPPORT=y
CONFIG_MTK_CAMERA_BSP_SUPPORT=y
CONFIG_MTK_CAM_ASD_SUPPORT=y
CONFIG_MTK_CAM_AUTORAMA_SUPPORT=y
CONFIG_MTK_CAM_EIS_SUPPORT=y
CONFIG_MTK_CAM_FACEBEAUTY_SUPPORT=y
CONFIG_MTK_CAM_FD_SUPPORT=y
CONFIG_MTK_CAM_GESTURE_SUPPORT=y
CONFIG_MTK_CAM_HDR_SUPPORT=y
CONFIG_MTK_CAM_OT_SUPPORT=y
CONFIG_MTK_CAM_SD_SUPPORT=y
CONFIG_MTK_CAM_VSS_SUPPORT=y
CONFIG_MTK_CAM_ZSD_SUPPORT=y
CONFIG_MTK_CDS_EM_SUPPORT=y
CONFIG_MTK_CHKIMGSIZE_SUPPORT=y
CONFIG_MTK_COMBO_SUPPORT=y
CONFIG_MTK_DATA_TRANSFER_APP=y
CONFIG_MTK_DHCPV6C_WIFI=y
CONFIG_MTK_DIALER_SEARCH_SUPPORT=y
CONFIG_MTK_DITHERING_SUPPORT=y
CONFIG_MTK_DP_FRAMEWORK=y
CONFIG_MTK_DRM_APP=y
CONFIG_MTK_EAP_SIM_AKA=y
CONFIG_MTK_EMMC_SUPPORT=y
CONFIG_MTK_ENABLE_MD1=y
CONFIG_MTK_ENGINEERMODE_APP=y
CONFIG_MTK_FACEBEAUTY_SUPPORT=y
CONFIG_MTK_FACTORY_MODE_IN_GB2312=y
CONFIG_MTK_FACTORY_RESET_PROTECTION_SUPPORT=y
CONFIG_MTK_FD_SUPPORT=y
CONFIG_MTK_FENCE_SUPPORT=y
CONFIG_MTK_FILEMANAGER_APP=y
CONFIG_MTK_FINGERPRINT=y
CONFIG_MTK_FLIGHT_MODE_POWER_OFF_MD=y
CONFIG_MTK_FLV_PLAYBACK_SUPPORT=y
CONFIG_MTK_FMRADIO_APP=y
CONFIG_MTK_FM_RECORDING_SUPPORT=y
CONFIG_MTK_FM_RX_SUPPORT=y
CONFIG_MTK_FM_SUPPORT=y
CONFIG_MTK_GAS_SERVICE_SUPPORT=y
CONFIG_MTK_GEMINI_ENHANCEMENT=y
CONFIG_MTK_GPS_SUPPORT=y
CONFIG_MTK_GPT_SCHEME_SUPPORT=y
CONFIG_MTK_GPU_SUPPORT=y
CONFIG_MTK_HANDSFREE_DMNR_SUPPORT=y
CONFIG_MTK_HETCOMM_SUPPORT=y
CONFIG_MTK_HIGH_QUALITY_THUMBNAIL=y
CONFIG_MTK_HIGH_RESOLUTION_AUDIO_SUPPORT=y
CONFIG_MTK_IDC_SUPPORT=y
CONFIG_MTK_IMS_SUPPORT=y
CONFIG_MTK_INCLUDE_MODEM_DB_IN_IMAGE=y
CONFIG_MTK_INPUTMETHOD_COOTEKIME_TOUCHPAL=y
CONFIG_MTK_ION_SUPPORT=y
CONFIG_MTK_IPOH_SUPPORT=n
CONFIG_MTK_IPV6_SUPPORT=y
CONFIG_MTK_KERNEL_POWER_OFF_CHARGING=y
CONFIG_MTK_LAUNCHER_UNREAD_SUPPORT=y
CONFIG_MTK_LCEEFT_SUPPORT=y
CONFIG_MTK_LCM_DEVICE_TREE_SUPPORT=
CONFIG_MTK_LIVEWALLPAPER_APP=y
CONFIG_MTK_LOMO_SUPPORT=y
CONFIG_MTK_LTE_SUPPORT=y
CONFIG_MTK_M4U_SUPPORT=y
CONFIG_MTK_MAV_PLAYBACK_SUPPORT=y
CONFIG_MTK_MD1_SUPPORT=5
CONFIG_MTK_MDLOGGER_SUPPORT=y
CONFIG_MTK_MD_SHUT_DOWN_NT=y
CONFIG_MTK_MFV_MPEG4_EXTRA=y
CONFIG_MTK_MIRAVISION_IMAGE_DC_SUPPORT=y
CONFIG_MTK_MIRAVISION_SETTING_SUPPORT=y
CONFIG_MTK_MMPROFILE_SUPPORT=y
CONFIG_MTK_MTKLOGGER_SUPPORT=y
CONFIG_MTK_MULTI_STORAGE_SUPPORT=y
CONFIG_MTK_NEON_SUPPORT=y
CONFIG_MTK_NETWORK_TYPE_ALWAYS_ON=y
CONFIG_MTK_NEW_COMBO_EMMC_SUPPORT=y
CONFIG_MTK_NEW_IPTABLES_SUPPORT=y
CONFIG_MTK_NFC=n
CONFIG_MTK_NFC_FW_MT6605=n
CONFIG_MTK_NFC_GSMA_SUPPORT=n
CONFIG_MTK_NFC_MT6605=n
CONFIG_MTK_NTFS_OPENSOURCE_SUPPORT=y
CONFIG_MTK_OMACP_SUPPORT=y
CONFIG_MTK_OMADRM_SUPPORT=y
CONFIG_MTK_OMA_DOWNLOAD_SUPPORT=y
CONFIG_MTK_PASSPOINT_R1_SUPPORT=y
CONFIG_MTK_PERFSERVICE_SUPPORT=y
CONFIG_MTK_PLATFORM_OPTIMIZE=y
CONFIG_MTK_PRODUCT_INFO_SUPPORT=y
CONFIG_MTK_PUMP_EXPRESS_PLUS_SUPPORT=
CONFIG_MTK_PUMP_EXPRESS_SUPPORT=
CONFIG_MTK_RILD_READ_IMSI=y
CONFIG_MTK_RTP_OVER_RTSP_SUPPORT=y
CONFIG_MTK_SEARCH_DB_SUPPORT=y
CONFIG_MTK_SEC_SECRO_AC_SUPPORT=y
CONFIG_MTK_SEND_RR_SUPPORT=y
CONFIG_MTK_SENSOR_SUPPORT=y
CONFIG_MTK_SHARED_SDCARD=y
CONFIG_MTK_SIGNATURE_CUSTOMIZATION=y
CONFIG_MTK_SIM_HOT_SWAP=y
CONFIG_MTK_SIM_RECOVERY=y
CONFIG_MTK_SIP_SUPPORT=y
CONFIG_MTK_SMS_TURKISH_TABLE_ALWAYS_SUPPORT=y
CONFIG_MTK_SPEAKER=
CONFIG_MTK_TETHERINGIPV6_SUPPORT=y
CONFIG_MTK_THERMAL_PA_VIA_ATCMD=y
CONFIG_MTK_TINY_UTIL=y
CONFIG_MTK_TLR_SUPPORT=y
CONFIG_MTK_TTY_SUPPORT=y
CONFIG_MTK_UMTS_TDD128_MODE=
CONFIG_MTK_USB_AUDIO_SUPPORT=y
CONFIG_MTK_USB_UNIQUE_SERIAL=y
CONFIG_MTK_USER_SPACE_DEBUG_FW=y
CONFIG_MTK_VIDEO_THUMBNAIL_PLAY_SUPPORT=y
CONFIG_MTK_VOICE_CONTACT_SEARCH_SUPPORT=y
CONFIG_MTK_VOICE_INTERFACE_EXTENSION_SUPPORT=y
CONFIG_MTK_VOICE_UI_SUPPORT=y
CONFIG_MTK_VOIP_ENHANCEMENT_SUPPORT=y
CONFIG_MTK_WAPI_SUPPORT=y
CONFIG_MTK_WAPPUSH_SUPPORT=y
CONFIG_MTK_WB_SPEECH_SUPPORT=y
CONFIG_MTK_WEB_NOTIFICATION_SUPPORT=y
CONFIG_MTK_WIFIWPSP2P_NFC_SUPPORT=n
CONFIG_MTK_WIFI_MCC_SUPPORT=y
CONFIG_MTK_WIFI_P2P_SUPPORT=y
CONFIG_MTK_WLAN_SUPPORT=y
CONFIG_MTK_WML_SUPPORT=y
CONFIG_MTK_WMV_PLAYBACK_SUPPORT=y
CONFIG_MTK_WVDRM_SUPPORT=y
CONFIG_MTK_YAML_SCATTER_FILE_SUPPORT=y
CONFIG_NFC_MT6605=n
CONFIG_ONEKEY_REBOOT_NORMAL_MODE=y
CONFIG_ONEKEY_REBOOT_OTHER_MODE=y
CONFIG_TWOKEY_REBOOT_NORMAL_MODE=
CONFIG_TWOKEY_REBOOT_OTHER_MODE=
CONFIG_USB_MTK_OTG=y
CONSYS_6735=yes
CONSYS_MT6735=yes
CONFIG_MAX_DRAM_SIZE=0x100000000
CONFIG_HAL_ANT=mt6735_ant_m1
CONFIG_HAL_AUDIOFLINGER=audio
CONFIG_HAL_BLUETOOTH=bluetooth
CONFIG_HAL_CAMERA=camera
CONFIG_HAL_CAM_CAL=dummy_eeprom
CONFIG_HAL_COMBO=mt6735
CONFIG_HAL_EEPROM=dummy_eeprom
CONFIG_HAL_FLASHLIGHT=constant_flashlight
CONFIG_HAL_IMGSENSOR=gc5024_mipi_raw gc5005_mipi_raw hi553_mipi_raw hi843b_mipi_raw hi841_mipi_raw mn045_mipi_raw hi544_mipi_raw
CONFIG_HAL_LENS=fm50af dw9714af
CONFIG_HAL_MAIN2_BACKUP_IMGSENSOR=
CONFIG_HAL_MAIN2_IMGSENSOR=
CONFIG_HAL_MAIN_BACKUP_IMGSENSOR=hi843b_mipi_raw
CONFIG_HAL_MAIN_BACKUP_LENS=fm50af
CONFIG_HAL_MAIN_IMGSENSOR=gc5024_mipi_raw hi841_mipi_raw mn045_mipi_raw
CONFIG_HAL_MAIN_LENS=fm50af dw9714af
CONFIG_HAL_MSENSORLIB=mmc328x akm8975 ami304 yamaha530 mag3110 akmd8963 bmm050 mc6420 mmc3416x s62xd lsm303md hscdtd006 qmc5983 qmc6983d akmd09911 mc64xx bmm056 mc41xx memsicd3524x
CONFIG_HAL_SENSORS=sensor
CONFIG_HAL_SUB_BACKUP_IMGSENSOR=hi553_mipi_raw hi544_mipi_raw
CONFIG_HAL_SUB_BACKUP_LENS=
CONFIG_HAL_SUB_IMGSENSOR=gc5005_mipi_raw
CONFIG_HAL_SUB_LENS=
CONFIG_KERNEL_ACCELEROMETER=KXTJ2_1009-new
CONFIG_KERNEL_ALSPS=epl259x-new
CONFIG_KERNEL_BATTERY=battery
CONFIG_KERNEL_CAMERA=camera
CONFIG_KERNEL_CAM_CAL=dummy_eeprom
CONFIG_KERNEL_CORE=src
CONFIG_KERNEL_DCT=dct
CONFIG_KERNEL_DTV=
CONFIG_KERNEL_EEPROM=dummy_eeprom
CONFIG_KERNEL_FLASHLIGHT=constant_flashlight
CONFIG_KERNEL_HALL=
CONFIG_KERNEL_HDMI=
CONFIG_KERNEL_HEADSET=accdet
CONFIG_KERNEL_IMGSENSOR=gc5024_mipi_raw gc5005_mipi_raw hi553_mipi_raw hi843b_mipi_raw hi841_mipi_raw mn045_mipi_raw hi544_mipi_raw
CONFIG_KERNEL_KPD=kpd
CONFIG_KERNEL_LCM=otm1283a_cmi50_tps65132_hd hx8394d_cmi50_blj_hd nt35521_boe50_xld_hd jd9365_inx50_jmg_hd rm68200_cpt50_blj_hd ili9881c_auo50_xzx_hd
CONFIG_KERNEL_LEDS=mt65xx
CONFIG_KERNEL_LENS=fm50af dw9714af
CONFIG_KERNEL_MAGNETOMETER=qmc6983-new
CONFIG_KERNEL_MAIN2_IMGSENSOR=
CONFIG_KERNEL_MAIN_BACKUP_IMGSENSOR=hi843b_mipi_raw
CONFIG_KERNEL_MAIN_BACKUP_LENS=fm50af
CONFIG_KERNEL_MAIN_IMGSENSOR=gc5024_mipi_raw hi841_mipi_raw mn045_mipi_raw
CONFIG_KERNEL_MAIN_LENS=fm50af dw9714af
CONFIG_KERNEL_RTC=rtc
CONFIG_KERNEL_SOUND=amp_6323pmic_spk
CONFIG_KERNEL_SSW=ssw_single_v2
CONFIG_KERNEL_SUB_BACKUP_IMGSENSOR=hi553_mipi_raw hi544_mipi_raw
CONFIG_KERNEL_SUB_BACKUP_LENS=
CONFIG_KERNEL_SUB_IMGSENSOR=gc5005_mipi_raw
CONFIG_KERNEL_SUB_LENS=
CONFIG_KERNEL_TOUCHKEY=
CONFIG_KERNEL_TOUCHPANEL=
CONFIG_KERNEL_USB=mt6577
CONFIG_KERNEL_VIBRATOR=vibrator
CONFIG_MODEM=vanzo_lte_modem_lwg
#####################################
```
