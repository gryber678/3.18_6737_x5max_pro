## block/Kconfig.iosched
```kconfig
if BLOCK

menu "IO Schedulers"


config IOSCHED_SIOPLUS
	tristate "Simple I/O scheduler"
	default y
	---help---
	  The Simple I/O scheduler tries to distribute bandwidth equally
	  among all processes in the system. It should provide a fair
	  and low latency working environment, suitable for both desktop
	  and server systems.

config CFQ_GROUP_IOSCHED
	bool "CFQ Group Scheduling support"
	depends on IOSCHED_CFQ && BLK_CGROUP
	default n
	---help---
	  Enable group IO scheduling in CFQ.

choice
	prompt "Default I/O scheduler"
	default DEFAULT_SIOPLUS
	help
	  Select the I/O scheduler which will be used by default for all
	  block devices.

	config DEFAULT_SIOPLUS
		bool "Sioplus" if IOSCHED_SIOPLUS=y

endchoice

config DEFAULT_IOSCHED
	string
	default "sioplus" if DEFAULT_SIOPLUS

endmenu

endif
```

## drivers/input/fingerprint/cs15xx/Kconfig
```kconfig
config FINGERPRINT_CS15XX
	bool "cs15xx(chipsailing fingerprint sensor)"
	default n
	help
	It support different type sensor
	in this platform. If this option
	is set, it will support fingerprint cs15xx/cs25xx fp sensor.
```

## drivers/input/fingerprint/gx368_otp/Kconfig
```kconfig
config FINGERPRINT_GT368
	bool "gf3208(goodix fingerprint sensor)  for dewav"
	default n
	help
	It support different type sensor
	in this platform. If this option
	is set, it will support fingerprint gf3208 silead sensor .
```

## drivers/misc/mediatek/accelerometer/lsm6ds3/Kconfig
```kconfig
config MTK_LSM6DS3
	bool "LSM6DS3 for MediaTek package"
	default n
	help
	  It support different accelerometer sensor.
          If this option is set,
	  it will support
          LSM6DS3 Accelerometer.
```

## drivers/misc/mediatek/accelerometer/qma6981/Kconfig
```kconfig
config MTK_QMA6981
	bool "QMA6981 for MediaTek package"
	default n
	help
	  It support different accelerometer sensor.
          If this option is set,
	  it will support
          QMA6981 Accelerometer.
```

## drivers/misc/mediatek/gyroscope/lsm6ds3gy/Kconfig
```kconfig
config MTK_LSM6DS3GY
        bool "LSM6DS3GY for MediaTek package"
        default n
	help
        It support different gyroscope sensor.
        If this option is set,
	  	it will support
        LSM6DS3GY gyroscope.
```
